## meta-auras/conf/layer.conf
```bitbake
BBPATH .= ":${LAYERDIR}"
BBFILES += "${LAYERDIR}/recipes-*/*/*.bb \
            ${LAYERDIR}/recipes-*/*/*.bbappend"
BBFILE_COLLECTIONS += "meta-auras"
BBFILE_PATTERN_meta-auras = "^${LAYERDIR}/"
BBFILE_PRIORITY_meta-auras = "31"
LAYERSERIES_COMPAT_meta-auras = "hardknott honister"
```

## meta-auras/meta-cdu_g3-project/conf/bblayers.conf.sample
```bitbake
# LAYER_CONF_VERSION is increased each time build/conf/bblayers.conf
# changes incompatibly
LCONF_VERSION = "14"

BBPATH = "${TOPDIR}"
BBFILES ?= ""

# meta-intel-openbmc has a config file that needs to be overridden
BBMASK = "/meta-intel-openbmc/meta-common/recipes-phosphor/ipmi/phosphor-ipmi-ipmb/"
BBMASK += "/meta-openbmc-mods/meta-common/recipes-phosphor/console/obmc-console_%.bbappend"
BBMASK += "/meta-phosphor/recipes-phosphor/webui/webui-vue_git.bb"
BBMASK += "/meta-openbmc-mods/meta-common/recipes-phosphor/webui/webui-vue_%.bbappend"
BBMASK += "/meta-openbmc-mods/meta-egs/recipes-phosphor/webui/webui-vue_%.bbappend"
BBMASK += "/meta-openbmc-mods/meta-common/recipes-core/os-release/"
#BBMASK += "/meta-insyde/meta-common/meta-core/recipes-extended/pam/"

# Use json for config led manager
BBMASK += "/meta-openbmc-mods/meta-common/recipes-phosphor/leds/phosphor-led-manager_%.bbappend"

BBLAYERS ?= " \
  ##OEROOT##/meta \
  ##OEROOT##/meta-poky \
  ##OEROOT##/meta-openembedded/meta-oe \
  ##OEROOT##/meta-openembedded/meta-networking \
  ##OEROOT##/meta-openembedded/meta-perl \
  ##OEROOT##/meta-openembedded/meta-python \
  ##OEROOT##/meta-phosphor \
  ##OEROOT##/meta-aspeed \
  ##OEROOT##/meta-x86 \
  ##OEROOT##/meta-insyde \
  ##OEROOT##/meta-insyde/meta-aspeed/meta-ast2600 \
  ##OEROOT##/meta-insyde/meta-aspeed/meta-ast2600/meta-chipset \
  ##OEROOT##/meta-insyde/meta-intel \
  ##OEROOT##/meta-insyde/meta-intel/meta-evb \
  ##OEROOT##/meta-insyde/meta-common/meta-obmc \
  ##OEROOT##/meta-insyde/meta-common/meta-core \
  ##OEROOT##/meta-insyde/meta-common/meta-core-append-srcrev \
  ##OEROOT##/meta-insyde/meta-common/meta-share \
  ##OEROOT##/meta-insyde/meta-common/meta-spv \
  ##OEROOT##/meta-openbmc-mods \
  ##OEROOT##/meta-intel-openbmc \
  ##OEROOT##/meta-openbmc-mods/meta-common \
  ##OEROOT##/meta-openbmc-mods/meta-common-small \
  ##OEROOT##/meta-openbmc-mods/meta-ast2600 \
  ##OEROOT##/meta-openbmc-mods/meta-egs \
  ##OEROOT##/meta-security \
  ##OEROOT##/meta-openbmc-mods/meta-restricted \
  "
BBLAYERS:prepend = " ##OEROOT##/meta-auras/meta-cdu_g3-project "
BBLAYERS:prepend = " ##OEROOT##/meta-auras "

BBMASK += "/meta-insyde/meta-intel/meta-evb/recipes-platform"
```

## meta-auras/meta-cdu_g3-project/conf/layer.conf
```bitbake
LOCALCONF_VERSION = "4"
# We have a conf and classes directory, add to BBPATH
BBPATH .= ":${LAYERDIR}"

BBFILES += "${LAYERDIR}/recipes-*/*/*.bb \
            ${LAYERDIR}/recipes-*/*/*.bbappend \
            ${LAYERDIR}/recipes-*/*.bbappend"

BBFILE_COLLECTIONS += "meta-auras-cdu_g3-project"
BBFILE_PATTERN_meta-auras-cdu_g3-project = "^${LAYERDIR}/"
BBFILE_PRIORITY_meta-auras-cdu_g3-project = "36"
LAYERSERIES_COMPAT_meta-auras-cdu_g3-project = "hardknott honister"
```

## meta-auras/meta-cdu_g3-project/conf/local.conf.sample
```bitbake
MACHINE ??= "auras-cdu_g3-project-cdu_g3_intel-ast2600-evb"
DISTRO ?= "openbmc-phosphor"
PACKAGE_CLASSES ?= "package_rpm"
SANITY_TESTED_DISTROS:append ?= " RedHatEnterpriseWorkstation-6.*"
EXTRA_IMAGE_FEATURES = "validation-unsecure"
# Uncomment the following line to enable debug features / default user account.
EXTRA_IMAGE_FEATURES += "debug-tweaks"
USER_CLASSES ?= "buildstats"
PATCHRESOLVE = "noop"

# PFR image Build
#IMAGE_FSTYPES += "intel-pfr"

TARGET_ID = "ast2600evb"

# Add license files to rootfs (/usr/share/common-licenses):
COPY_LIC_MANIFEST = "1"
COPY_LIC_DIRS = "1"

BB_DISKMON_DIRS ??= "\
    STOPTASKS,${TMPDIR},1G,100K \
    STOPTASKS,${DL_DIR},1G,100K \
    STOPTASKS,${SSTATE_DIR},1G,100K \
    STOPTASKS,/tmp,100M,100K \
    ABORT,${TMPDIR},100M,1K \
    ABORT,${DL_DIR},100M,1K \
    ABORT,${SSTATE_DIR},100M,1K \
    ABORT,/tmp,10M,1K"
CONF_VERSION = "4"
BB_NUMBER_THREADS = "10"
PARALLEL_MAKE = "-j 10"

FULL_OPTIMIZATION = "-Os -pipe ${DEBUG_FLAGS}"
#SSTATE_DIR="~/.yocto/sstate"
#DL_DIR="~/.yocto/download"

# The following class prints the SRC_URI of each recipe in the build
# Once enabled, run 'bitbake intel-platforms --runonly print_src'
# on a clean workspace to get the output
#INHERIT += "print-src"

BB_GENERATE_MIRROR_TARBALLS = "1"

export SPF_VERSION = "5.0"

IMAGE_INSTALL:remove = " mctpd phosphor-ipmi-ipmb phosphor-node-manager-proxy at-scale-debug"

PREMIRRORS:prepend = "\
    git://.*/.*    file://${COREBASE}/meta-insyde/meta-intel/downloads/ \n \
    git://github.com/Intel-BMC/    git://git@github.com/Intel-BMC/;protocol=ssh \n \
"
LICENSE_FLAGS_WHITELIST += " InsydeOpfRestrictedLicense "
```

## meta-auras/meta-cdu_g3-project/conf/machine/auras-cdu_g3-project-cdu_g3_intel-ast2600-evb.conf
```bitbake
require conf/machine/intel-ast2600-evb.conf
MACHINEOVERRIDES:append= ":intel-ast2600-evb"
```
